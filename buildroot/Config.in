## buildroot/Config.in
```kconfig
source "$BR2_EXTERNAL_HYDRA_PATH/package/hydra-host/Config.in"
source "$BR2_EXTERNAL_HYDRA_PATH/package/hydra-ui/Config.in"
```

## buildroot/configs/hydra_cm5_defconfig
```kconfig
# Hydra Printer — Buildroot defconfig for Raspberry Pi CM5
#
# Build: make BR2_EXTERNAL=<path-to-hydra-firmware/buildroot> hydra_cm5_defconfig
#        make

# Architecture
BR2_aarch64=y

# Raspberry Pi CM5 (BCM2712)
BR2_LINUX_KERNEL=y
BR2_LINUX_KERNEL_CUSTOM_TARBALL=y
BR2_LINUX_KERNEL_CUSTOM_TARBALL_LOCATION="https://github.com/raspberrypi/linux/archive/refs/tags/stable_20250305.tar.gz"
BR2_LINUX_KERNEL_DEFCONFIG="bcm2712"
BR2_LINUX_KERNEL_DTS_SUPPORT=y
BR2_LINUX_KERNEL_INTREE_DTS_NAME="broadcom/bcm2712-rpi-cm5-cm5io"
BR2_LINUX_KERNEL_NEEDS_HOST_OPENSSL=y

# Bootloader (RPi firmware + U-Boot)
BR2_PACKAGE_RPI_FIRMWARE=y
BR2_PACKAGE_RPI_FIRMWARE_VARIANT_PI5=y

# Toolchain
BR2_TOOLCHAIN_BUILDROOT_CXX=y
BR2_GCC_VERSION_14_X=y

# Filesystem
BR2_TARGET_ROOTFS_EXT2=y
BR2_TARGET_ROOTFS_EXT2_4=y
BR2_TARGET_ROOTFS_EXT2_SIZE="2G"

# Image generation
BR2_ROOTFS_POST_BUILD_SCRIPT="$(BR2_EXTERNAL_HYDRA_PATH)/board/hydra/post-build.sh"
BR2_ROOTFS_POST_IMAGE_SCRIPT="$(BR2_EXTERNAL_HYDRA_PATH)/board/hydra/post-image.sh"
BR2_ROOTFS_OVERLAY="$(BR2_EXTERNAL_HYDRA_PATH)/rootfs-overlay"

# Init system
BR2_INIT_SYSTEMD=y

# Network
BR2_PACKAGE_WPA_SUPPLICANT=y
BR2_PACKAGE_WPA_SUPPLICANT_NL80211=y
BR2_PACKAGE_WPA_SUPPLICANT_AP_SUPPORT=y
BR2_PACKAGE_DHCPCD=y

# Display / Chromium kiosk
BR2_PACKAGE_CHROMIUM=y
BR2_PACKAGE_MESA3D=y
BR2_PACKAGE_MESA3D_GALLIUM_DRIVER_V3D=y
BR2_PACKAGE_LIBDRM=y
BR2_PACKAGE_LIBINPUT=y
BR2_PACKAGE_EUDEV=y

# SPI + GPIO (for MCU communication)
BR2_PACKAGE_SPIDEV_TEST=y

# Utilities
BR2_PACKAGE_NANO=y
BR2_PACKAGE_HTOP=y
BR2_PACKAGE_OPENSSH=y
BR2_PACKAGE_DROPBEAR=n

# Hydra packages
BR2_PACKAGE_HYDRA_HOST=y
BR2_PACKAGE_HYDRA_UI=y

# Timezone & locale
BR2_TARGET_TZ_INFO=y
BR2_TARGET_LOCALTIME="UTC"
BR2_SYSTEM_DEFAULT_PATH="/usr/local/bin:/usr/bin:/bin:/usr/sbin:/sbin"
```

## buildroot/package/hydra-host/Config.in
```kconfig
config BR2_PACKAGE_HYDRA_HOST
	bool "hydra-host"
	depends on BR2_INSTALL_LIBSTDCPP
	depends on BR2_TOOLCHAIN_GCC_AT_LEAST_14
	select BR2_PACKAGE_SPDLOG
	select BR2_PACKAGE_NLOHMANN_JSON
	help
	  Hydra 3D printer host daemon.
	  Manages G-code parsing, motion planning, thermal control,
	  and communication with the RP2040 MCU via SPI.
```

## buildroot/package/hydra-ui/Config.in
```kconfig
config BR2_PACKAGE_HYDRA_UI
	bool "hydra-ui"
	help
	  Hydra 3D printer web UI.
	  Pre-built React + TypeScript application served by hydra-host
	  on port 5000 (also used in Chromium kiosk on the touchscreen).
```
